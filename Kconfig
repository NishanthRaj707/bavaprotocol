## Kconfig
```kconfig
# BAVA Protocol Root Kconfig Configuration
# Compatible with Zephyr RTOS Kconfig and ESP-IDF Component Kconfig

menu "BAVA Protocol Configuration"

config BAVA_PROTOCOL
    bool "Enable BAVA Protocol Support"
    default y
    help
      Enables native library support for the BAVA (Bidirectional Asynchronous Versatile Architecture) Protocol.

      BAVA is an ultra-low latency, zero-heap binary communication protocol designed for resource-constrained
      embedded microcontrollers and real-time operating systems (Zephyr RTOS, ESP-IDF, FreeRTOS, Bare-Metal).

      Key Features & Empirical Performance:
        - O(1) Multi-Variable Dictionary Routing: Direct indexed variable binding with zero lookup overhead.
        - High-Integrity Framing: CRC-16-CCITT (polynomial 0x1021) checksum validation with byte-escaping sync framing.
        - Sub-Hundred-Microsecond Latency: 64us to 84us frame formatting and TX execution latency.
        - Zero Dynamic Memory Footprint: Proven O(1) static memory complexity with zero malloc()/free() dynamic heap calls.
        - Ultra-Low Stack Consumption: Requires < 100 bytes of task stack footprint.

endmenu
```
